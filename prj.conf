## CMakeLists.txt
```
cmake_minimum_required(VERSION 3.8)
include($ENV{ZEPHYR_BASE}/cmake/app/boilerplate.cmake NO_POLICY_SCOPE)
project(NONE)

zephyr_include_directories(src/dloader)

target_sources(app PRIVATE src/main.c)
target_sources(app PRIVATE src/dloader/dl_cmd_download.c)
#target_sources(app PRIVATE src/dloader/dl_stdio.c)
target_sources(app PRIVATE src/dloader/dl_channel.c)
target_sources(app PRIVATE src/dloader/dl_crc.c)
target_sources(app PRIVATE src/dloader/dl_packet.c)
target_sources(app PRIVATE src/dloader/dl_cmd_proc.c)
```

## prj.conf
```kconfig
# nothing here

CONFIG_XIP=n
CONFIG_BOOT_BANNER=n

#CONFIG_MBEDTLS=y
#CONFIG_MBEDTLS_BUILTIN=y
#CONFIG_MBEDTLS_CFG_FILE="config-mini-pbkdf2.h"

#CONFIG_SHELL=y
#CONFIG_LOG=y
#CONFIG_LOG_STRDUP_MAX_STRING=128
#CONFIG_LOG_STRDUP_BUF_COUNT=16

#To enable fdl log output, need 2 procedures:
# 1. set below configs to y
# 2. Change default console to UART_2 in file boards/arm/96b_ivy5661/96b_ivy5661.dts
CONFIG_AON_UART_UWP=n
CONFIG_PRINTK=n
CONFIG_CONSOLE=n
CONFIG_UART_CONSOLE=n
CONFIG_STDOUT_CONSOLE=n

CONFIG_WATCHDOG=n
CONFIG_WDT_UWP=n
CONFIG_SIPC=n
```

## src/main.c
```c
/*
 * SPDX-License-Identifier: Apache-2.0
 */

#include <zephyr.h>
#include <misc/printk.h>
#include <device.h>
#include <uart.h>
#include <hal_sfc.h>

#include "dloader/dl_channel.h"
#include "dloader/dl_cmd_common.h"

#ifdef SYS_LOG_DOMAIN
#undef SYS_LOG_DOMAIN
#endif
#define SYS_LOG_DOMAIN	"UNISOC"

void main(void)
{
	int ret;
	unsigned int  key;

	key = irq_lock_primask();
    ret = dl_channel_init();
	if(ret) {
		FDL_PRINT("Init channel failed.\n");
		return;
	}

	do_download();
	irq_unlock_primask(key);
	while(1) {}
}
```
